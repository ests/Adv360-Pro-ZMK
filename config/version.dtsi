#define VERSION_MACRO
macro_ver: macro_ver {
compatible = "zmk,behavior-macro";
#binding-cells = <0>;
bindings = <&kp N2>, <&kp N0>, <&kp N2>, <&kp N5>, <&kp N0>, <&kp N3>, <&kp N0>, <&kp N4>, <&kp MINUS>, <&kp T>, <&kp H>, <&kp U>, <&kp N>, <&kp MINUS>, <&kp N7>, <&kp N1>, <&kp N4>, <&kp N4>, <&kp N2>, <&kp N7>, <&kp B>, <&kp MINUS>, <&kp C>, <&kp L>, <&kp I>, <&kp Q>, <&kp U>, <&kp E>, <&kp RET>;
};
