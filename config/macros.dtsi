macro_c_u: macro_c_u{
compatible = "zmk,behavior-macro";
label = "macro_c_u";
#binding-cells = <0>;
bindings = <&sk LEFT_CONTROL>, <&kp U>;
};
macro_c_d: macro_c_d{
compatible = "zmk,behavior-macro";
label = "macro_c_d";
#binding-cells = <0>;
bindings = <&sk LEFT_CONTROL>, <&kp D>;
};
macro_cmd_space: macro_cmd_space{
compatible = "zmk,behavior-macro";
label = "macro_cmd_space";
#binding-cells = <0>;
bindings = <&sk LCMD>, <&kp SPACE>;
};